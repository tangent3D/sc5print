#include <WiFi.h>

// Network credentials
const char* ssid = "Jasper's Realm";
const char* password = "5541006C9D";

const char HAI[] =
{
  0x1B, 0x26, 0x6C, 0x6F, 0x36, 0x44, 0x1B, 0x28, 0x38, 0x55, 0x1B, 0x28,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 0x30,
  0x56, 0x0D, 0x1B, 0x26, 0x61, 0x2B, 0x36, 0x39, 0x36, 0x48, 0x48, 0x41, 0x49, 0x21, 0x0C, 0x1B, 0x26, 0x6C, 0x30, 0x6F, 0x33, 0x65, 0x31, 0x48, 0x00
};

void initWiFi()
{
  WiFi.mode(WIFI_STA);
  WiFi.begin(ssid, password);
  while (WiFi.status() != WL_CONNECTED);
  Serial.println(WiFi.localIP());
}

void setup()
{
  Serial.begin(9600);
  while (!Serial);
  initWiFi();

  WiFiClient client;

  if (client.connect("192.168.50.50", 9100))
  {
      if (client.connected())
      {
        client.print(HAI);
      }
  }

}

// the loop function runs over and over again forever
void loop()
{

}
